/*
 * Copyright (C) 2010 - 2023 Novatek, Inc.
 *
 * $Revision$
 * $Date$
 *
 * This program is free software; you can redistribute it and/or modify
 * it under the terms of the GNU General Public License as published by
 * the Free Software Foundation; either version 2 of the License, or
 * (at your option) any later version.
 *
 * This program is distributed in the hope that it will be useful, but WITHOUT
 * ANY WARRANTY; without even the implied warranty of MERCHANTABILITY or
 * FITNESS FOR A PARTICULAR PURPOSE.  See the GNU General Public License for
 * more details.
 *
 */


&spi0 {
	status = "okay";
	#address-cells = <1>;
	#size-cells = <0>;

	touch@0 {
		compatible = "novatek,NVT-ts-spi","focaltech,fts","omnivision,tcm-spi","chipone-tddi";
		reg = <0>; //Same as CS ID
		status = "ok";

		spi-max-frequency = <9600000>;	//4800000,9600000,15000000,19200000
		/*************** Chipone TDDI touchscreen driver device tree source include file ***************/
		chipone,rst-gpio = <&pio 92 0x00>;
        chipone,irq-gpio = <&pio 1 0x2001>;
        //chipone,cs-gpio = <&msm_gpio 8 0>;
        chipone,x-res = <719>;
        chipone,y-res = <1599>;

        /* Charger detect */
        chipone,touch-charger-detect-enable;
        chipone,touch-charger-detect-type = "notify"; /* notify, poll */
        chipone,touch-charger-detect-psy-name = "charger";
        chipone,touch-charger-detect-psp = "POWER_SUPPLY_PROP_ONLINE";
        chipone,touch-charger-detect-psp-poll-interval = <1000>;

        /* Earjack detect */
        chipone,touch-earjack-detect-enable;
        /* MTK:  /sys/bus/platform/drivers/Accdet_Driver/state,
           Sprd: /sys/kernel/headset/state
           QCOM: None, and disable it */
        chipone,touch-earjack-state-filepath = "/sys/bus/platform/drivers/Accdet_Driver/state";
        chipone,touch-earjack-poll-interval = <1000>;

        /* For tp selftest */
		chipone,test-reset-pin;
		chipone,test-int-pin;
		chipone,test-rawdata;
		chipone,test-rawdata-frames      = <1>;
		chipone,rawdata-min              = <100>;
		chipone,rawdata-max              = <10000>;
		chipone,test-noise;
		chipone,test-noise-frames        = <50>;
		chipone,noise-max                = <1000>;
		chipone,test-open;
		chipone,open-min                 = <200>;
		chipone,test-short;
		chipone,short-min                = <200>;
		chipone,test-compensate-cap;
		chipone,compensate-cap-min       = <1>;
		chipone,compensate-cap-max       = <127>;

		/* gesture data test */
		chipone,test-gesture-rawdata;
		chipone,test-gesture-rawdata-frames = <1>;
		chipone,gesture-rawdata-min = <100>;
		chipone,gesture-rawdata-max = <10000>;

		chipone,test-gesture-lp-rawdata;
		chipone,test-gesture-lp-rawdata-frames = <1>;
		chipone,gesture-lp-rawdata-min = <100>;
		chipone,gesture-lp-rawdata-max = <10000>;

		chipone,test-gesture-noise;
		chipone,test-gesture-noise-frames = <50>;
		chipone,gesture-noise-max = <1000>;

		chipone,test-gesture-lp-noise;
		chipone,test-gesture-lp-noise-frames = <50>;
		chipone,gesture-lp-noise-max = <1000>;
		/*************** Focaltech FT8057P device tree ***************/
                focaltech,reset-gpio = <&pio 92 0x00>;
		focaltech,irq-gpio = <&pio 1 0x2001>;
		focaltech,max-touch-number = <10>;
		focaltech,display-coords =  <0 0 719 1599>;

		/*************** Novatek NT36528 device tree ***************/
		novatek,reset-gpio = <&pio 92 0x00>;
		novatek,irq-gpio = <&pio 1 0x2001>;
		//novatek,pen-support;
		//novatek,spi-rd-fast-addr = <0x03F310>;

		/* MP */
		novatek,mp-support-dt;

		omnivision,irq-gpio = <&pio 1 0x2001>;
		omnivision,reset-gpio = <&pio 92 0x00>;
		omnivision,spi-mode = <3>;

		/* for Xiaomi C3U NT36528 Truly 6.745" panel module */
		novatek-mp-criteria-597D@0 {
			#address-cells = <1>;
			#size-cells = <0>;
			compatible = "novatek-mp-criteria-597D";

			/* MP Config */
			IC_X_CFG_SIZE = <18>;
			IC_Y_CFG_SIZE = <32>;
			IC_KEY_CFG_SIZE = <4>;
			X_Channel = <18>;
			Y_Channel = <32>;
			AIN_X = <0 1 2 3 4 5 6 7 8 9 10 11 12 13 14 15 16 17>;
			AIN_Y = <0 1 2 3 4 5 6 7 8 9 10 11 12 13 14 15 16 17 18 19 20 21 22 23 24 25 26 27 28 29 30 31>;
			AIN_KEY = <0 1 2 0xFF>;

			/* MP Criteria */
			PS_Config_Lmt_Short_Rawdata_P = <
				14008 14008 14008 14008 14008 14008 14008 14008 14008 14008 14008 14008 14008 14008 14008 14008 14008 14008
				14008 14008 14008 14008 14008 14008 14008 14008 14008 14008 14008 14008 14008 14008 14008 14008 14008 14008
				14008 14008 14008 14008 14008 14008 14008 14008 14008 14008 14008 14008 14008 14008 14008 14008 14008 14008
				14008 14008 14008 14008 14008 14008 14008 14008 14008 14008 14008 14008 14008 14008 14008 14008 14008 14008
				14008 14008 14008 14008 14008 14008 14008 14008 14008 14008 14008 14008 14008 14008 14008 14008 14008 14008
				14008 14008 14008 14008 14008 14008 14008 14008 14008 14008 14008 14008 14008 14008 14008 14008 14008 14008
				14008 14008 14008 14008 14008 14008 14008 14008 14008 14008 14008 14008 14008 14008 14008 14008 14008 14008
				14008 14008 14008 14008 14008 14008 14008 14008 14008 14008 14008 14008 14008 14008 14008 14008 14008 14008
				14008 14008 14008 14008 14008 14008 14008 14008 14008 14008 14008 14008 14008 14008 14008 14008 14008 14008
				14008 14008 14008 14008 14008 14008 14008 14008 14008 14008 14008 14008 14008 14008 14008 14008 14008 14008
				14008 14008 14008 14008 14008 14008 14008 14008 14008 14008 14008 14008 14008 14008 14008 14008 14008 14008
				14008 14008 14008 14008 14008 14008 14008 14008 14008 14008 14008 14008 14008 14008 14008 14008 14008 14008
				14008 14008 14008 14008 14008 14008 14008 14008 14008 14008 14008 14008 14008 14008 14008 14008 14008 14008
				14008 14008 14008 14008 14008 14008 14008 14008 14008 14008 14008 14008 14008 14008 14008 14008 14008 14008
				14008 14008 14008 14008 14008 14008 14008 14008 14008 14008 14008 14008 14008 14008 14008 14008 14008 14008
				14008 14008 14008 14008 14008 14008 14008 14008 14008 14008 14008 14008 14008 14008 14008 14008 14008 14008
				14008 14008 14008 14008 14008 14008 14008 14008 14008 14008 14008 14008 14008 14008 14008 14008 14008 14008
				14008 14008 14008 14008 14008 14008 14008 14008 14008 14008 14008 14008 14008 14008 14008 14008 14008 14008
				14008 14008 14008 14008 14008 14008 14008 14008 14008 14008 14008 14008 14008 14008 14008 14008 14008 14008
				14008 14008 14008 14008 14008 14008 14008 14008 14008 14008 14008 14008 14008 14008 14008 14008 14008 14008
				14008 14008 14008 14008 14008 14008 14008 14008 14008 14008 14008 14008 14008 14008 14008 14008 14008 14008
				14008 14008 14008 14008 14008 14008 14008 14008 14008 14008 14008 14008 14008 14008 14008 14008 14008 14008
				14008 14008 14008 14008 14008 14008 14008 14008 14008 14008 14008 14008 14008 14008 14008 14008 14008 14008
				14008 14008 14008 14008 14008 14008 14008 14008 14008 14008 14008 14008 14008 14008 14008 14008 14008 14008
				14008 14008 14008 14008 14008 14008 14008 14008 14008 14008 14008 14008 14008 14008 14008 14008 14008 14008
				14008 14008 14008 14008 14008 14008 14008 14008 14008 14008 14008 14008 14008 14008 14008 14008 14008 14008
				14008 14008 14008 14008 14008 14008 14008 14008 14008 14008 14008 14008 14008 14008 14008 14008 14008 14008
				14008 14008 14008 14008 14008 14008 14008 14008 14008 14008 14008 14008 14008 14008 14008 14008 14008 14008
				14008 14008 14008 14008 14008 14008 14008 14008 14008 14008 14008 14008 14008 14008 14008 14008 14008 14008
				14008 14008 14008 14008 14008 14008 14008 14008 14008 14008 14008 14008 14008 14008 14008 14008 14008 14008
				14008 14008 14008 14008 14008 14008 14008 14008 14008 14008 14008 14008 14008 14008 14008 14008 14008 14008
				14008 14008 14008 14008 14008 14008 14008 14008 14008 14008 14008 14008 14008 14008 14008 14008 14008 14008
				14008 14008 14008>;

			PS_Config_Lmt_Short_Rawdata_N = <
				10100	10100	10100	10100	10100	10100	10100	10100	10100	10100	10100	10100	10100	10100	10100	10100	10100	10100
				10100	10100	10100	10100	10100	10100	10100	10100	10100	10100	10100	10100	10100	10100	10100	10100	10100	10100
				10100	10100	10100	10100	10100	10100	10100	10100	10100	10100	10100	10100	10100	10100	10100	10100	10100	10100
				10100	10100	10100	10100	10100	10100	10100	10100	10100	10100	10100	10100	10100	10100	10100	10100	10100	10100
				10100	10100	10100	10100	10100	10100	10100	10100	10100	10100	10100	10100	10100	10100	10100	10100	10100	10100
				10100	10100	10100	10100	10100	10100	10100	10100	10100	10100	10100	10100	10100	10100	10100	10100	10100	10100
				10100	10100	10100	10100	10100	10100	10100	10100	10100	10100	10100	10100	10100	10100	10100	10100	10100	10100
				10100	10100	10100	10100	10100	10100	10100	10100	10100	10100	10100	10100	10100	10100	10100	10100	10100	10100
				10100	10100	10100	10100	10100	10100	10100	10100	10100	10100	10100	10100	10100	10100	10100	10100	10100	10100
				10100	10100	10100	10100	10100	10100	10100	10100	10100	10100	10100	10100	10100	10100	10100	10100	10100	10100
				10100	10100	10100	10100	10100	10100	10100	10100	10100	10100	10100	10100	10100	10100	10100	10100	10100	10100
				10100	10100	10100	10100	10100	10100	10100	10100	10100	10100	10100	10100	10100	10100	10100	10100	10100	10100
				10100	10100	10100	10100	10100	10100	10100	10100	10100	10100	10100	10100	10100	10100	10100	10100	10100	10100
				10100	10100	10100	10100	10100	10100	10100	10100	10100	10100	10100	10100	10100	10100	10100	10100	10100	10100
				10100	10100	10100	10100	10100	10100	10100	10100	10100	10100	10100	10100	10100	10100	10100	10100	10100	10100
				10100	10100	10100	10100	10100	10100	10100	10100	10100	10100	10100	10100	10100	10100	10100	10100	10100	10100
				10100	10100	10100	10100	10100	10100	10100	10100	10100	10100	10100	10100	10100	10100	10100	10100	10100	10100
				10100	10100	10100	10100	10100	10100	10100	10100	10100	10100	10100	10100	10100	10100	10100	10100	10100	10100
				10100	10100	10100	10100	10100	10100	10100	10100	10100	10100	10100	10100	10100	10100	10100	10100	10100	10100
				10100	10100	10100	10100	10100	10100	10100	10100	10100	10100	10100	10100	10100	10100	10100	10100	10100	10100
				10100	10100	10100	10100	10100	10100	10100	10100	10100	10100	10100	10100	10100	10100	10100	10100	10100	10100
				10100	10100	10100	10100	10100	10100	10100	10100	10100	10100	10100	10100	10100	10100	10100	10100	10100	10100
				10100	10100	10100	10100	10100	10100	10100	10100	10100	10100	10100	10100	10100	10100	10100	10100	10100	10100
				10100	10100	10100	10100	10100	10100	10100	10100	10100	10100	10100	10100	10100	10100	10100	10100	10100	10100
				10100	10100	10100	10100	10100	10100	10100	10100	10100	10100	10100	10100	10100	10100	10100	10100	10100	10100
				10100	10100	10100	10100	10100	10100	10100	10100	10100	10100	10100	10100	10100	10100	10100	10100	10100	10100
				10100	10100	10100	10100	10100	10100	10100	10100	10100	10100	10100	10100	10100	10100	10100	10100	10100	10100
				10100	10100	10100	10100	10100	10100	10100	10100	10100	10100	10100	10100	10100	10100	10100	10100	10100	10100
				10100	10100	10100	10100	10100	10100	10100	10100	10100	10100	10100	10100	10100	10100	10100	10100	10100	10100
				10100	10100	10100	10100	10100	10100	10100	10100	10100	10100	10100	10100	10100	10100	10100	10100	10100	10100
				10100	10100	10100	10100	10100	10100	10100	10100	10100	10100	10100	10100	10100	10100	10100	10100	10100	10100
				10100	10100	10100	10100	10100	10100	10100	10100	10100	10100	10100	10100	10100	10100	10100	10100	10100	10100
				10000 10000 10000>;

			PS_Config_Lmt_Open_Rawdata_P = <
				2571	2566	2515	2457	2403	2373	2318	2293	65535	65535	2065	2081	2112	2130	2164	2186	2217	2251
				2436	2443	2420	2382	2347	2324	2308	2286	2263	2328	2338	2350	2356	2364	2371	2370	2391	2431
				2627	2636	2611	2571	2536	2506	2486	2465	2436	2207	2216	2221	2233	2245	2255	2259	2270	2312
				2489	2517	2496	2465	2431	2402	2382	2360	2339	2375	2384	2395	2406	2415	2423	2427	2443	2479
				2632	2668	2637	2602	2559	2525	2508	2478	2457	2293	2305	2311	2322	2328	2332	2340	2359	2394
				2532	2574	2542	2507	2471	2440	2422	2399	2378	2486	2499	2508	2518	2525	2534	2541	2555	2588
				2637	2623	2584	2553	2508	2483	2479	2457	2430	2340	2350	2363	2360	2374	2380	2381	2415	2332
				2486	2465	2429	2398	2357	2332	2326	2303	2279	2528	2536	2549	2545	2566	2576	2581	2613	2555
				2699	2669	2633	2606	2564	2532	2532	2499	2473	2443	2457	2462	2459	2468	2478	2476	2510	2451
				2599	2566	2531	2499	2458	2424	2422	2395	2373	2587	2599	2615	2606	2616	2630	2633	2658	2616
				2818	2774	2734	2703	2665	2637	2626	2602	2583	2483	2493	2508	2507	2518	2534	2528	2562	2532
				2696	2657	2622	2597	2557	2532	2520	2493	2471	2737	2746	2762	2758	2769	2781	2780	2814	2795
				2924	2878	2843	2812	2774	2744	2731	2710	2679	2633	2639	2655	2643	2651	2662	2654	2685	2675
				2787	2744	2707	2678	2640	2612	2604	2583	2556	2702	2707	2717	2713	2724	2731	2728	2759	2756
				3021	2972	2931	2900	2864	2830	2823	2793	2770	2623	2636	2647	2648	2655	2662	2655	2685	2700
				2877	2829	2790	2765	2725	2696	2689	2661	2640	2816	2823	2832	2830	2839	2854	2858	2889	2913
				3116	3064	3019	2989	2948	2914	2907	2877	2860	2774	2781	2791	2781	2788	2800	2801	2833	2861
				2994	2945	2912	2879	2829	2797	2781	2753	2735	2906	2914	2933	2931	2940	2948	2948	2977	3014
				3210	3168	3133	3096	3059	3022	2998	2975	2945	2798	2797	2818	2811	2822	2830	2823	2854	2884
				3101	3052	3017	2982	2942	2920	2905	2881	2853	3005	3014	3031	3025	3026	3040	3039	3071	3116
				3312	3260	3218	3186	3145	3124	3117	3089	3053	2924	2937	2947	2942	2954	2962	2956	2987	3031
				3193	3144	3115	3077	3039	3012	3005	2982	2954	3116	3129	3143	3137	3150	3161	3165	3189	3235
				3437	3386	3341	3313	3271	3239	3228	3197	3171	3042	3067	3075	3078	3089	3099	3099	3126	3161
				3302	3250	3214	3187	3151	3119	3103	3082	3059	3232	3250	3256	3255	3263	3273	3280	3306	3353
				3564	3519	3481	3451	3407	3378	3360	3326	3292	3137	3151	3166	3159	3161	3175	3172	3203	3245
				3432	3389	3353	3320	3278	3252	3235	3214	3180	3305	3326	3339	3343	3354	3362	3357	3381	3421
				3637	3592	3547	3511	3470	3449	3432	3409	3369	3213	3227	3241	3248	3253	3256	3260	3295	3340
				3607	3564	3533	3498	3453	3428	3414	3381	3350	3423	3432	3449	3451	3455	3467	3469	3491	3536
				3682	3801	3764	3729	3683	3644	3626	3593	3551	3336	3354	3364	3369	3374	3383	3385	3423	3344
				3453	3575	3550	3516	3483	3453	3437	3406	3378	3512	3528	3549	3557	3567	3575	3579	3595	3500
				3701	3861	3827	3788	3747	3708	3691	3659	3626	3427	3445	3459	3455	3459	3470	3467	3493	3390
				3584	3761	3754	3714	3677	3651	3634	3610	3575	3585	3602	3612	3616	3630	3648	3655	3652	3509
				5120 5120 5120>;

			PS_Config_Lmt_Open_Rawdata_N = <
				1102	1099	1078	1053	1030	1017	993	982	(-65535)	(-65535)	885	892	905	913	927	937	950	964           
				1044	1047	1037	1021	1006	996	989	979	970	997	1002	1007	1009	1013	1016	1015	1024	1042          
				1126	1129	1119	1102	1087	1074	1065	1056	1044	946	949	952	957	962	966	968	973	991                 
				1066	1078	1069	1056	1042	1029	1021	1011	1002	1018	1021	1026	1031	1035	1038	1040	1047	1062
				1128	1143	1130	1115	1096	1082	1075	1062	1053	982	988	990	995	997	999	1003	1011	1026            
				1085	1103	1089	1074	1059	1045	1038	1028	1019	1065	1071	1075	1079	1082	1086	1089	1095	1109
				1130	1124	1107	1094	1075	1064	1062	1053	1041	1003	1007	1012	1011	1017	1020	1020	1035	999 
				1065	1056	1041	1027	1010	999	997	987	976	1083	1087	1092	1090	1099	1104	1106	1120	1095        
				1156	1144	1128	1117	1099	1085	1085	1071	1060	1047	1053	1055	1054	1057	1062	1061	1075	1050
				1114	1099	1084	1071	1053	1039	1038	1026	1017	1108	1114	1120	1117	1121	1127	1128	1139	1121
				1207	1189	1171	1158	1142	1130	1125	1115	1107	1064	1068	1075	1074	1079	1086	1083	1098	1085
				1155	1138	1123	1113	1096	1085	1080	1068	1059	1173	1177	1183	1182	1186	1192	1191	1206	1198
				1253	1233	1218	1205	1189	1176	1170	1161	1148	1128	1131	1138	1132	1136	1141	1137	1150	1146
				1194	1176	1160	1147	1131	1119	1116	1107	1095	1158	1160	1164	1162	1167	1170	1169	1182	1181
				1294	1273	1256	1243	1227	1213	1210	1197	1187	1124	1129	1134	1135	1138	1141	1138	1150	1157
				1233	1212	1195	1185	1168	1155	1152	1140	1131	1207	1210	1213	1213	1216	1223	1225	1238	1248
				1335	1313	1294	1281	1263	1249	1246	1233	1225	1189	1192	1196	1192	1195	1200	1200	1214	1226
				1283	1262	1248	1234	1212	1198	1192	1180	1172	1245	1249	1257	1256	1260	1263	1263	1276	1291
				1375	1357	1342	1327	1311	1295	1285	1275	1262	1199	1198	1207	1204	1209	1213	1210	1223	1236
				1329	1308	1293	1278	1261	1251	1245	1234	1222	1288	1291	1299	1296	1297	1303	1302	1316	1335
				1419	1397	1379	1365	1348	1339	1336	1324	1308	1253	1258	1263	1261	1266	1269	1267	1280	1299
				1368	1347	1335	1318	1302	1291	1288	1278	1266	1335	1341	1347	1344	1350	1354	1356	1366	1386
				1473	1451	1432	1420	1402	1388	1383	1370	1359	1303	1314	1318	1319	1324	1328	1328	1339	1354
				1415	1393	1377	1366	1350	1336	1330	1321	1311	1385	1393	1395	1395	1398	1402	1405	1417	1437
				1527	1508	1492	1479	1460	1447	1440	1425	1411	1344	1350	1357	1354	1354	1360	1359	1372	1390
				1471	1452	1437	1423	1405	1393	1386	1377	1363	1416	1425	1431	1432	1437	1441	1438	1449	1466
				1558	1539	1520	1504	1487	1478	1471	1461	1444	1377	1383	1389	1392	1394	1395	1397	1412	1431
				1546	1527	1514	1499	1480	1469	1463	1449	1435	1467	1471	1478	1479	1480	1486	1486	1496	1515
				1578	1629	1613	1598	1578	1561	1554	1540	1522	1429	1437	1441	1444	1446	1450	1450	1467	1433
				1480	1532	1521	1507	1492	1480	1473	1459	1447	1505	1512	1521	1524	1528	1532	1534	1540	1500
				1586	1654	1640	1623	1606	1589	1582	1568	1554	1468	1476	1482	1480	1482	1487	1486	1497	1453
				1536	1612	1609	1591	1576	1564	1557	1547	1532	1536	1543	1548	1549	1555	1563	1566	1565	1504
				(-511) (-511) (-511)>;

			PS_Config_Lmt_FW_Rawdata_P = <
				1124	1118	1121	1124	1125	1134	1118	1122	65535	65535	1129	1125	1121	1124	1118	1124	1118	1120
				1110	1115	1120	1121	1122	1113	1113	1122	1108	1122	1118	1121	1127	1114	1131	1124	1128	1118
				1124	1115	1118	1122	1129	1118	1111	1117	1117	1128	1120	1134	1135	1113	1122	1128	1125	1120
				1107	1124	1128	1117	1124	1115	1122	1125	1131	1121	1118	1122	1121	1124	1120	1124	1124	1132
				1121	1121	1124	1122	1124	1121	1114	1118	1121	1117	1128	1120	1118	1125	1110	1118	1115	1120
				1115	1108	1120	1110	1129	1118	1125	1125	1120	1118	1120	1114	1115	1121	1120	1125	1118	1124
				1128	1118	1113	1129	1118	1111	1118	1115	1118	1111	1107	1118	1131	1114	1124	1115	1114	1110
				1120	1118	1110	1127	1122	1117	1121	1121	1118	1132	1125	1121	1121	1125	1127	1110	1125	1121
				1131	1117	1135	1124	1113	1134	1115	1118	1122	1124	1125	1111	1122	1115	1121	1124	1117	1118
				1131	1120	1131	1122	1107	1134	1110	1128	1103	1120	1136	1122	1117	1120	1115	1114	1125	1122
				1117	1124	1134	1118	1117	1125	1122	1121	1129	1127	1111	1111	1111	1111	1128	1128	1121	1118
				1104	1113	1124	1121	1115	1124	1132	1110	1131	1117	1120	1122	1120	1121	1120	1132	1117	1106
				1114	1120	1124	1118	1121	1128	1122	1115	1125	1131	1115	1120	1129	1124	1114	1101	1135	1131
				1120	1127	1121	1124	1118	1114	1115	1125	1122	1129	1125	1117	1124	1134	1114	1131	1127	1120
				1121	1114	1111	1118	1132	1122	1121	1127	1128	1121	1134	1101	1110	1115	1124	1121	1110	1118
				1108	1121	1125	1117	1117	1129	1120	1117	1124	1124	1128	1120	1117	1111	1122	1114	1117	1120
				1135	1117	1113	1121	1107	1129	1122	1124	1124	1117	1122	1128	1115	1132	1120	1118	1131	1117
				1125	1135	1122	1120	1118	1108	1125	1122	1108	1118	1115	1113	1125	1120	1120	1108	1136	1120
				1129	1110	1122	1113	1131	1129	1111	1132	1122	1124	1131	1110	1118	1107	1122	1120	1103	1118
				1115	1120	1134	1110	1100	1122	1121	1125	1122	1120	1115	1125	1127	1108	1114	1120	1136	1122
				1115	1120	1118	1107	1122	1117	1121	1113	1117	1115	1113	1125	1131	1135	1121	1104	1114	1113
				1122	1129	1117	1121	1118	1118	1106	1115	1122	1122	1115	1113	1121	1117	1131	1114	1129	1117
				1111	1136	1115	1131	1127	1118	1136	1121	1115	1114	1118	1125	1120	1122	1125	1124	1120	1134
				1120	1124	1131	1118	1114	1111	1115	1132	1124	1122	1117	1118	1127	1110	1107	1135	1124	1129
				1135	1110	1121	1125	1118	1110	1111	1104	1111	1113	1118	1118	1121	1114	1118	1115	1125	1118
				1118	1111	1120	1114	1111	1121	1118	1120	1113	1124	1127	1127	1131	1113	1111	1117	1128	1120
				1117	1122	1110	1121	1118	1117	1121	1125	1124	1121	1124	1108	1111	1113	1120	1125	1118	1127
				1108	1129	1128	1115	1127	1127	1120	1121	1115	1122	1114	1117	1129	1129	1118	1121	1099	1124
				1121	1122	1120	1129	1124	1128	1117	1122	1127	1129	1120	1107	1101	1117	1132	1132	1121	1132
				1117	1124	1113	1104	1114	1125	1141	1142	1111	1127	1118	1125	1117	1122	1121	1120	1128	1124
				1127	1124	1121	1113	1124	1125	1129	1122	1121	1122	1124	1122	1120	1125	1117	1122	1117	1128
				1113	1108	1122	1122	1115	1127	1118	1113	1118	1113	1115	1113	1120	1124	1132	1118	1113	1125
				3840 3840 3840>;

			PS_Config_Lmt_FW_Rawdata_N = <
				481	479	480	481	482	486	479	481	(-65535)	(-65535)	484	482	480	481	479	481	479	480
				475	478	480	480	481	477	477	481	475	481	479	480	483	477	484	481	483	479            
				481	478	479	481	484	479	476	478	478	483	480	486	486	477	481	483	482	480            
				474	481	483	478	481	478	481	482	484	480	479	481	480	481	480	481	481	485            
				480	480	481	481	481	480	477	479	480	478	483	480	479	482	475	479	478	480            
				478	475	480	475	484	479	482	482	480	479	480	477	478	480	480	482	479	481            
				483	479	477	484	479	476	479	478	479	476	474	479	484	477	481	478	477	475            
				480	479	475	483	481	478	480	480	479	485	482	480	480	482	483	475	482	480            
				484	478	486	481	477	486	478	479	481	481	482	476	481	478	480	481	478	479            
				484	480	484	481	474	486	475	483	472	480	487	481	478	480	478	477	482	481            
				478	481	486	479	478	482	481	480	484	483	476	476	476	476	483	483	480	479            
				473	477	481	480	478	481	485	475	484	478	480	481	480	480	480	485	478	474            
				477	480	481	479	480	483	481	478	482	484	478	480	484	481	477	472	486	484            
				480	483	480	481	479	477	478	482	481	484	482	478	481	486	477	484	483	480            
				480	477	476	479	485	481	480	483	483	480	486	472	475	478	481	480	475	479            
				475	480	482	478	478	484	480	478	481	481	483	480	478	476	481	477	478	480            
				486	478	477	480	474	484	481	481	481	478	481	483	478	485	480	479	484	478            
				482	486	481	480	479	475	482	481	475	479	478	477	482	480	480	475	487	480            
				484	475	481	477	484	484	476	485	481	481	484	475	479	474	481	480	472	479            
				478	480	486	475	471	481	480	482	481	480	478	482	483	475	477	480	487	481            
				478	480	479	474	481	478	480	477	478	478	477	482	484	486	480	473	477	477            
				481	484	478	480	479	479	474	478	481	481	478	477	480	478	484	477	484	478            
				476	487	478	484	483	479	487	480	478	477	479	482	480	481	482	481	480	486            
				480	481	484	479	477	476	478	485	481	481	478	479	483	475	474	486	481	484            
				486	475	480	482	479	475	476	473	476	477	479	479	480	477	479	478	482	479            
				479	476	480	477	476	480	479	480	477	481	483	483	484	477	476	478	483	480            
				478	481	475	480	479	478	480	482	481	480	481	475	476	477	480	482	479	483            
				475	484	483	478	483	483	480	480	478	481	477	478	484	484	479	480	471	481            
				480	481	480	484	481	483	478	481	483	484	480	474	472	478	485	485	480	485            
				478	481	477	473	477	482	489	489	476	483	479	482	478	481	480	480	483	481            
				483	481	480	477	481	482	484	481	480	481	481	481	480	482	478	481	478	483            
				477	475	481	481	478	483	479	477	479	477	478	477	480	481	485	479	477	482            
				240 240 240>;

			PS_Config_Lmt_FW_CC_P = <
				91	91	89	86	84	82	80	80	65535	65535	78	78	81	82	85	86	89	91
				92	91	86	85	84	82	80	78	77	77	78	80	81	82	85	86	91	92    
				92	91	88	86	84	82	81	80	78	78	80	81	82	85	88	89	91	93    
				92	91	88	88	85	82	81	80	78	78	78	81	82	84	86	88	91	93    
				92	91	89	88	86	84	82	80	80	80	80	82	85	86	89	89	92	93    
				93	93	91	91	89	88	84	82	81	80	81	82	85	88	89	91	92	95    
				93	91	89	84	82	81	80	78	77	78	80	81	82	85	86	92	93	93    
				92	91	88	82	81	80	78	77	75	77	78	80	81	82	84	89	92	92    
				92	91	88	82	82	80	80	78	77	78	80	81	82	84	86	91	92	93    
				93	91	88	84	82	81	80	78	77	78	80	81	81	84	85	89	91	92    
				95	91	88	84	82	81	80	80	77	80	81	82	82	84	86	91	92	95    
				93	91	89	84	82	82	81	80	78	80	82	82	84	85	88	91	93	95    
				93	91	89	85	84	82	82	81	80	82	84	86	86	88	89	92	93	96    
				93	92	89	86	85	82	82	82	81	81	82	84	85	86	88	91	92	95    
				96	93	91	88	86	85	84	82	81	82	85	86	86	88	89	91	93	96    
				95	92	91	89	88	86	85	84	82	82	84	86	88	88	89	91	93	95    
				95	93	91	89	89	88	88	85	84	88	89	91	91	91	92	93	96	99    
				97	93	92	91	89	89	88	88	85	86	88	89	89	91	91	92	95	97    
				97	95	92	91	91	91	89	89	88	89	91	92	92	92	93	95	97	99    
				99	95	93	92	91	91	91	89	89	89	91	91	92	92	93	93	96	99    
				99	97	95	93	93	92	92	92	92	92	92	93	93	93	95	95	97	100   
				102	99	96	95	95	95	95	93	93	93	93	95	95	95	95	96	99	100   
				104	103	100	100	100	99	100	99	99	99	99	100	100	100	100	102	103	104   
				104	103	100	100	100	99	99	99	99	99	99	99	99	100	100	100	102	104   
				107	104	103	102	102	102	102	102	102	102	102	102	102	102	102	103	104	106   
				107	106	103	103	103	103	103	103	103	102	102	102	102	102	103	103	104	106   
				109	106	104	104	104	104	104	104	104	104	104	104	104	104	104	104	106	109   
				110	109	106	106	106	106	106	106	107	106	106	106	106	104	106	106	107	109   
				117	111	109	110	109	109	110	110	110	107	107	107	107	107	107	107	109	114   
				113	109	107	107	107	107	107	107	110	109	107	107	107	107	107	107	110	113   
				114	111	110	110	110	110	110	110	111	110	109	109	109	109	109	109	110	114   
				115	114	113	113	113	113	114	114	114	111	110	110	110	110	110	109	111	115   
				314 314 314>;

			PS_Config_Lmt_FW_CC_N = <
				40	40	40	39	37	37	35	35	(-65535)	(-65535)	35	35	36	37	38	39	40	40
				41	40	39	38	37	37	35	35	34	34	35	35	36	37	38	39	40	41            
				41	40	39	39	37	37	36	35	35	35	35	36	37	38	39	40	40	42            
				41	40	39	39	38	37	36	35	35	35	35	36	37	37	39	39	40	42            
				41	40	40	39	39	37	37	35	35	35	35	37	38	39	40	40	41	42            
				42	42	40	40	40	39	37	37	36	35	36	37	38	39	40	40	41	42            
				42	40	40	37	37	36	35	35	34	35	35	36	37	38	39	41	42	42            
				41	40	39	37	36	35	35	34	34	34	35	35	36	37	37	40	41	41            
				41	40	39	37	37	35	35	35	34	35	35	36	37	37	39	40	41	42            
				42	40	39	37	37	36	35	35	34	35	35	36	36	37	38	40	40	41            
				42	40	39	37	37	36	35	35	34	35	36	37	37	37	39	40	41	42            
				42	40	40	37	37	37	36	35	35	35	37	37	37	38	39	40	42	42            
				42	40	40	38	37	37	37	36	35	37	37	39	39	39	40	41	42	43            
				42	41	40	39	38	37	37	37	36	36	37	37	38	39	39	40	41	42            
				43	42	40	39	39	38	37	37	36	37	38	39	39	39	40	40	42	43            
				42	41	40	40	39	39	38	37	37	37	37	39	39	39	40	40	42	42            
				42	42	40	40	40	39	39	38	37	39	40	40	40	40	41	42	43	44            
				44	42	41	40	40	40	39	39	38	39	39	40	40	40	40	41	42	44            
				44	42	41	40	40	40	40	40	39	40	40	41	41	41	42	42	44	44            
				44	42	42	41	40	40	40	40	40	40	40	40	41	41	42	42	43	44            
				44	44	42	42	42	41	41	41	41	41	41	42	42	42	42	42	44	45            
				45	44	43	42	42	42	42	42	42	42	42	42	42	42	42	43	44	45            
				47	46	45	45	45	44	45	44	44	44	44	45	45	45	45	45	46	47            
				47	46	45	45	45	44	44	44	44	44	44	44	44	45	45	45	45	47            
				48	47	46	45	45	45	45	45	45	45	45	45	45	45	45	46	47	47            
				48	47	46	46	46	46	46	46	46	45	45	45	45	45	46	46	47	47            
				48	47	47	47	47	47	47	47	47	47	47	47	47	47	47	47	47	48            
				49	48	47	47	47	47	47	47	48	47	47	47	47	47	47	47	48	48            
				52	50	48	49	48	48	49	49	49	48	48	48	48	48	48	48	48	51            
				50	48	48	48	48	48	48	48	49	48	48	48	48	48	48	48	49	50            
				51	50	49	49	49	49	49	49	50	49	48	48	48	48	48	48	49	51            
				52	51	50	50	50	50	51	51	51	50	49	49	49	49	49	48	50	52            
				0 0 0>;

			PS_Config_Lmt_FW_Diff_P = <
				50	50	50	50	50	50	50	50	65535	65535	50	50	50	50	50	50	50	50
				50	50	50	50	50	50	50	50	50	50	50	50	50	50	50	50	50	50    
				50	50	50	50	50	50	50	50	50	50	50	50	50	50	50	50	50	50    
				50	50	50	50	50	50	50	50	50	50	50	50	50	50	50	50	50	50    
				50	50	50	50	50	50	50	50	50	50	50	50	50	50	50	50	50	50    
				50	50	50	50	50	50	50	50	50	50	50	50	50	50	50	50	50	50    
				50	50	50	50	50	50	50	50	50	50	50	50	50	50	50	50	50	50    
				50	50	50	50	50	50	50	50	50	50	50	50	50	50	50	50	50	50    
				50	50	50	50	50	50	50	50	50	50	50	50	50	50	50	50	50	50    
				50	50	50	50	50	50	50	50	50	50	50	50	50	50	50	50	50	50    
				50	50	50	50	50	50	50	50	50	50	50	50	50	50	50	50	50	50    
				50	50	50	50	50	50	50	50	50	50	50	50	50	50	50	50	50	50    
				50	50	50	50	50	50	50	50	50	50	50	50	50	50	50	50	50	50    
				50	50	50	50	50	50	50	50	50	50	50	50	50	50	50	50	50	50    
				50	50	50	50	50	50	50	50	50	50	50	50	50	50	50	50	50	50    
				50	50	50	50	50	50	50	50	50	50	50	50	50	50	50	50	50	50    
				50	50	50	50	50	50	50	50	50	50	50	50	50	50	50	50	50	50    
				50	50	50	50	50	50	50	50	50	50	50	50	50	50	50	50	50	50    
				50	50	50	50	50	50	50	50	50	50	50	50	50	50	50	50	50	50    
				50	50	50	50	50	50	50	50	50	50	50	50	50	50	50	50	50	50    
				50	50	50	50	50	50	50	50	50	50	50	50	50	50	50	50	50	50    
				50	50	50	50	50	50	50	50	50	50	50	50	50	50	50	50	50	50    
				50	50	50	50	50	50	50	50	50	50	50	50	50	50	50	50	50	50    
				50	50	50	50	50	50	50	50	50	50	50	50	50	50	50	50	50	50    
				50	50	50	50	50	50	50	50	50	50	50	50	50	50	50	50	50	50    
				50	50	50	50	50	50	50	50	50	50	50	50	50	50	50	50	50	50    
				50	50	50	50	50	50	50	50	50	50	50	50	50	50	50	50	50	50    
				50	50	50	50	50	50	50	50	50	50	50	50	50	50	50	50	50	50    
				50	50	50	50	50	50	50	50	50	50	50	50	50	50	50	50	50	50    
				50	50	50	50	50	50	50	50	50	50	50	50	50	50	50	50	50	50    
				50	50	50	50	50	50	50	50	50	50	50	50	50	50	50	50	50	50    
				50	50	50	50	50	50	50	50	50	50	50	50	50	50	50	50	50	50    
				75 75 75>;

			PS_Config_Lmt_FW_Diff_N = <
				(-50)	(-50)	(-50)	(-50)	(-50)	(-50)	(-50)	(-50)	(-65535)	(-65535)	(-50)	(-50)	(-50)	(-50)	(-50)	(-50)	(-50)	(-50)
				(-50)	(-50)	(-50)	(-50)	(-50)	(-50)	(-50)	(-50)	(-50)	(-50)	(-50)	(-50)	(-50)	(-50)	(-50)	(-50)	(-50)	(-50)        
				(-50)	(-50)	(-50)	(-50)	(-50)	(-50)	(-50)	(-50)	(-50)	(-50)	(-50)	(-50)	(-50)	(-50)	(-50)	(-50)	(-50)	(-50)        
				(-50)	(-50)	(-50)	(-50)	(-50)	(-50)	(-50)	(-50)	(-50)	(-50)	(-50)	(-50)	(-50)	(-50)	(-50)	(-50)	(-50)	(-50)        
				(-50)	(-50)	(-50)	(-50)	(-50)	(-50)	(-50)	(-50)	(-50)	(-50)	(-50)	(-50)	(-50)	(-50)	(-50)	(-50)	(-50)	(-50)        
				(-50)	(-50)	(-50)	(-50)	(-50)	(-50)	(-50)	(-50)	(-50)	(-50)	(-50)	(-50)	(-50)	(-50)	(-50)	(-50)	(-50)	(-50)        
				(-50)	(-50)	(-50)	(-50)	(-50)	(-50)	(-50)	(-50)	(-50)	(-50)	(-50)	(-50)	(-50)	(-50)	(-50)	(-50)	(-50)	(-50)        
				(-50)	(-50)	(-50)	(-50)	(-50)	(-50)	(-50)	(-50)	(-50)	(-50)	(-50)	(-50)	(-50)	(-50)	(-50)	(-50)	(-50)	(-50)        
				(-50)	(-50)	(-50)	(-50)	(-50)	(-50)	(-50)	(-50)	(-50)	(-50)	(-50)	(-50)	(-50)	(-50)	(-50)	(-50)	(-50)	(-50)        
				(-50)	(-50)	(-50)	(-50)	(-50)	(-50)	(-50)	(-50)	(-50)	(-50)	(-50)	(-50)	(-50)	(-50)	(-50)	(-50)	(-50)	(-50)        
				(-50)	(-50)	(-50)	(-50)	(-50)	(-50)	(-50)	(-50)	(-50)	(-50)	(-50)	(-50)	(-50)	(-50)	(-50)	(-50)	(-50)	(-50)        
				(-50)	(-50)	(-50)	(-50)	(-50)	(-50)	(-50)	(-50)	(-50)	(-50)	(-50)	(-50)	(-50)	(-50)	(-50)	(-50)	(-50)	(-50)        
				(-50)	(-50)	(-50)	(-50)	(-50)	(-50)	(-50)	(-50)	(-50)	(-50)	(-50)	(-50)	(-50)	(-50)	(-50)	(-50)	(-50)	(-50)        
				(-50)	(-50)	(-50)	(-50)	(-50)	(-50)	(-50)	(-50)	(-50)	(-50)	(-50)	(-50)	(-50)	(-50)	(-50)	(-50)	(-50)	(-50)        
				(-50)	(-50)	(-50)	(-50)	(-50)	(-50)	(-50)	(-50)	(-50)	(-50)	(-50)	(-50)	(-50)	(-50)	(-50)	(-50)	(-50)	(-50)        
				(-50)	(-50)	(-50)	(-50)	(-50)	(-50)	(-50)	(-50)	(-50)	(-50)	(-50)	(-50)	(-50)	(-50)	(-50)	(-50)	(-50)	(-50)        
				(-50)	(-50)	(-50)	(-50)	(-50)	(-50)	(-50)	(-50)	(-50)	(-50)	(-50)	(-50)	(-50)	(-50)	(-50)	(-50)	(-50)	(-50)        
				(-50)	(-50)	(-50)	(-50)	(-50)	(-50)	(-50)	(-50)	(-50)	(-50)	(-50)	(-50)	(-50)	(-50)	(-50)	(-50)	(-50)	(-50)        
				(-50)	(-50)	(-50)	(-50)	(-50)	(-50)	(-50)	(-50)	(-50)	(-50)	(-50)	(-50)	(-50)	(-50)	(-50)	(-50)	(-50)	(-50)        
				(-50)	(-50)	(-50)	(-50)	(-50)	(-50)	(-50)	(-50)	(-50)	(-50)	(-50)	(-50)	(-50)	(-50)	(-50)	(-50)	(-50)	(-50)        
				(-50)	(-50)	(-50)	(-50)	(-50)	(-50)	(-50)	(-50)	(-50)	(-50)	(-50)	(-50)	(-50)	(-50)	(-50)	(-50)	(-50)	(-50)        
				(-50)	(-50)	(-50)	(-50)	(-50)	(-50)	(-50)	(-50)	(-50)	(-50)	(-50)	(-50)	(-50)	(-50)	(-50)	(-50)	(-50)	(-50)        
				(-50)	(-50)	(-50)	(-50)	(-50)	(-50)	(-50)	(-50)	(-50)	(-50)	(-50)	(-50)	(-50)	(-50)	(-50)	(-50)	(-50)	(-50)        
				(-50)	(-50)	(-50)	(-50)	(-50)	(-50)	(-50)	(-50)	(-50)	(-50)	(-50)	(-50)	(-50)	(-50)	(-50)	(-50)	(-50)	(-50)        
				(-50)	(-50)	(-50)	(-50)	(-50)	(-50)	(-50)	(-50)	(-50)	(-50)	(-50)	(-50)	(-50)	(-50)	(-50)	(-50)	(-50)	(-50)        
				(-50)	(-50)	(-50)	(-50)	(-50)	(-50)	(-50)	(-50)	(-50)	(-50)	(-50)	(-50)	(-50)	(-50)	(-50)	(-50)	(-50)	(-50)        
				(-50)	(-50)	(-50)	(-50)	(-50)	(-50)	(-50)	(-50)	(-50)	(-50)	(-50)	(-50)	(-50)	(-50)	(-50)	(-50)	(-50)	(-50)        
				(-50)	(-50)	(-50)	(-50)	(-50)	(-50)	(-50)	(-50)	(-50)	(-50)	(-50)	(-50)	(-50)	(-50)	(-50)	(-50)	(-50)	(-50)        
				(-50)	(-50)	(-50)	(-50)	(-50)	(-50)	(-50)	(-50)	(-50)	(-50)	(-50)	(-50)	(-50)	(-50)	(-50)	(-50)	(-50)	(-50)        
				(-50)	(-50)	(-50)	(-50)	(-50)	(-50)	(-50)	(-50)	(-50)	(-50)	(-50)	(-50)	(-50)	(-50)	(-50)	(-50)	(-50)	(-50)        
				(-50)	(-50)	(-50)	(-50)	(-50)	(-50)	(-50)	(-50)	(-50)	(-50)	(-50)	(-50)	(-50)	(-50)	(-50)	(-50)	(-50)	(-50)        
				(-50)	(-50)	(-50)	(-50)	(-50)	(-50)	(-50)	(-50)	(-50)	(-50)	(-50)	(-50)	(-50)	(-50)	(-50)	(-50)	(-50)	(-50)        
				(-75) (-75) (-75)>;

			PS_Config_Diff_Test_Frame = <50>;
		};
	};
	
};
